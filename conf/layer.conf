## conf/layer.conf
```bitbake
# We have a conf and classes directory, add to BBPATH
BBPATH .= ":${LAYERDIR}"

# We have recipes-* directories, add to BBFILES
BBFILES += "${LAYERDIR}/recipes-*/*/*.bb \
	${LAYERDIR}/recipes-*/*/*.bbappend"

BBFILE_COLLECTIONS += "swupdate-boards"
BBFILE_PATTERN_swupdate-boards = "^${LAYERDIR}/"
BBFILE_PRIORITY_swupdate-boards = "7"

LAYERDEPENDS_swupdate-boards = "swupdate"

LAYERSERIES_COMPAT_swupdate-boards = "scarthgap"

BBFILES_DYNAMIC += " \
    atmel:${LAYERDIR}/dynamic-layers/atmel/*/*/*.bb \
    atmel:${LAYERDIR}/dynamic-layers/atmel/*/*/*.bbappend \
    \
    raspberrypi:${LAYERDIR}/dynamic-layers/raspberrypi/*/*/*.bb \
    raspberrypi:${LAYERDIR}/dynamic-layers/raspberrypi/*/*/*.bbappend \
"
```

## scripts/lib/wic/canned-wks/wandboard.wks
```
# short-description: Create SD card image with a boot partition
# long-description:
# Create an image that can be written onto a SD card using dd for use
# with i.MX SoC family.
# It uses SPL and u-boot
#
# The disk layout used is:
#  - ----- --------- --------------
# | | SPL | u-boot  |    rootfs    |
#  - ----- --------- --------------
# ^ ^     ^         ^              ^
# | |     |         |              |
# 0 1kiB  69kiB   4MiB + rootfs + IMAGE_EXTRA_SPACE (default 10MiB)
#
part SPL --source rawcopy --sourceparams="file=SPL" --ondisk mmcblk --no-table --align 1
part u-boot --source rawcopy --sourceparams="file=u-boot.img" --ondisk mmcblk --no-table --align 69
part / --source rootfs --ondisk mmcblk --fstype=ext4 --label rootfs1 --align 4096 --fixed-size=800M
part /mnt --ondisk mmcblk --fstype=ext4 --label rootfs2 --align 4096 --fixed-size=800M

bootloader --ptable msdos
```
